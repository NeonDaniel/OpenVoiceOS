## buildroot-external/package/neon-service/Config.in
```kconfig
config BR2_PACKAGE_NEON_SERVICE
	bool "neon-service"
	help
	  Start the Neon A.I. software as service.

	  https://neon.ai/
```

## buildroot-external/package/python-neon-core/Config.in
```kconfig
config BR2_PACKAGE_PYTHON_NEON_CORE
	bool "python-neon-core"
	help
	  Neon Core, the Neon Artificial Intelligence platform.
	  packaged as importable library. 

	  https://neon.ai/
```
